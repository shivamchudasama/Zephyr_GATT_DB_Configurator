## CMakeLists.txt
```
# SPDX-License-Identifier: MIT
cmake_minimum_required(VERSION 3.20.0)

find_package(Zephyr REQUIRED HINTS $ENV{ZEPHYR_BASE})
project(bulkxfer_server)

target_sources(app PRIVATE
   src/main.c
   src/app_log.c
   src/BulkXfer_Service.c
)

target_include_directories(app PRIVATE
   src
   ${CMAKE_CURRENT_LIST_DIR}/..
   ${CMAKE_CURRENT_LIST_DIR}/../../../AppLog
)

# Server role only: this board never sends bulk data
zephyr_compile_definitions(BLK_ENABLE_CLIENT=0)

# Library sources (each CMakeLists adds its *.c files to the app target)
add_subdirectory(${CMAKE_CURRENT_LIST_DIR}/../../../GATT_CB GATT_CB)
add_subdirectory(${CMAKE_CURRENT_LIST_DIR}/../.. BulkXfer)
```

## prj.conf
```kconfig
# SPDX-License-Identifier: MIT
# BulkXfer server peripheral - throughput-oriented baseline for nRF54 + NCS.

CONFIG_LOG=y
CONFIG_CRC=y
CONFIG_MAIN_STACK_SIZE=2048

CONFIG_BT=y
CONFIG_BT_PERIPHERAL=y
CONFIG_BT_DEVICE_NAME="BulkXfer"
CONFIG_BT_MAX_CONN=1
# Lets the server start the ATT MTU exchange itself (clients usually do too).
# The BulkXfer Client role is compiled out in CMakeLists.txt.
CONFIG_BT_GATT_CLIENT=y

# ATT_MTU 247 -> 244-byte write payload = one 251-byte LL packet.
CONFIG_BT_L2CAP_TX_MTU=247
CONFIG_BT_BUF_ACL_RX_SIZE=251
CONFIG_BT_BUF_ACL_TX_SIZE=251
CONFIG_BT_CTLR_DATA_LENGTH_MAX=251

# Link tuning requested by gv_BLKS_OnConnected() (b_autoTuneLink = true).
CONFIG_BT_USER_DATA_LEN_UPDATE=y
CONFIG_BT_USER_PHY_UPDATE=y
CONFIG_BT_CTLR_PHY_2M=y

# Enough host/controller buffers to fill each connection event.
# BulkXfer's in-flight credits must stay below BT_ATT_TX_COUNT (build-checked).
CONFIG_BT_ATT_TX_COUNT=10
CONFIG_BT_CONN_TX_MAX=10
CONFIG_BT_BUF_ACL_TX_COUNT=10
# Must exceed BT_BUF_ACL_TX_COUNT (one completion event per ACL buffer).
CONFIG_BT_BUF_EVT_RX_COUNT=11
CONFIG_BT_ATT_PREPARE_COUNT=0

# Let the SoftDevice Controller extend connection events for many packets.
CONFIG_BT_CTLR_SDC_MAX_CONN_EVENT_LEN_DEFAULT=4000000

# Preferred connection interval 7.5-15 ms (units of 1.25 ms).
CONFIG_BT_PERIPHERAL_PREF_MIN_INT=6
CONFIG_BT_PERIPHERAL_PREF_MAX_INT=12
CONFIG_BT_PERIPHERAL_PREF_LATENCY=0
CONFIG_BT_PERIPHERAL_PREF_TIMEOUT=400
```

## src/main.c
```c
/**
 * @file          main.c
 * @brief         BulkXfer server peripheral.
 *
 *                - Hosts the BulkXfer service and receives every transfer a
 *                  client writes into it. Data goes to a discarding sink; the
 *                  library verifies the CRC-32.
 *                - After each transfer, notifies a short message
 *                  APP_TYPE_RESULT = { status(1), length(4 LE), kbit/s(4 LE) }.
 *                - Echoes every short message back (ping).
 *
 *                Use it with examples/bulk_client on a second board, or with
 *                tools/bulkxfer_client.py from a PC.
 *
 * @date          24/09/2026
 * @author        Shivam Chudasama
 * @copyright     Shivam Chudasama
 * @license       MIT
 */

/* SPDX-License-Identifier: MIT */

/******************************************************************************/
/*                                                                            */
/*                                  INCLUDES                                  */
/*                                                                            */
/******************************************************************************/
#include <zephyr/kernel.h>
#include <zephyr/bluetooth/bluetooth.h>
#include <zephyr/bluetooth/conn.h>
#include <zephyr/sys/byteorder.h>
#include "BulkXfer.h"
#include "BulkXfer_Service.h"
#include "AppLog.h"

/******************************************************************************/
/*                                                                            */
/*                                  DEFINES                                   */
/*                                                                            */
/******************************************************************************/
/**
 * @def           APP_TYPE_RESULT
 * @brief         Short message type of the per-transfer result report.
 */
#define APP_TYPE_RESULT                      (0x01U)

/******************************************************************************/
/*                                                                            */
/*                                   ENUMS                                    */
/*                                                                            */
/******************************************************************************/

/******************************************************************************/
/*                                                                            */
/*                                 STRUCTURES                                 */
/*                                                                            */
/******************************************************************************/

/******************************************************************************/
/*                                                                            */
/*                                   UNIONS                                   */
/*                                                                            */
/******************************************************************************/

/******************************************************************************/
/*                                                                            */
/*                       PRIVATE FUNCTION DECLARATIONS                        */
/*                                                                            */
/******************************************************************************/
static int si_OnRxStart(uint8_t u8_appType, uint32_t u32_totalLen);
static int si_OnRxData(uint8_t u8_appType, uint32_t u32_offset,
   const uint8_t *u8pt_data, uint16_t u16_len);
static void sv_OnRxDone(uint8_t u8_appType, BlkStatus_E e_status, uint32_t u32_totalLen);
static void sv_OnRxShort(uint8_t u8_appType, const uint8_t *u8pt_data, uint8_t u8_len);
static void sv_Connected(struct bt_conn *stpt_conn, uint8_t u8_err);
static void sv_Disconnected(struct bt_conn *stpt_conn, uint8_t u8_reason);
static void sv_Recycled(void);
static void sv_AdvWork(struct k_work *stpt_work);

/******************************************************************************/
/*                                                                            */
/*                              EXTERN VARIABLES                              */
/*                                                                            */
/******************************************************************************/

/******************************************************************************/
/*                                                                            */
/*                              PUBLIC VARIABLES                              */
/*                                                                            */
/******************************************************************************/
/**
 * @var           gst_connCallbacks
 * @brief         Connection callbacks. BT_CONN_CB_DEFINE gives the object
 *                external linkage.
 */
BT_CONN_CB_DEFINE(gst_connCallbacks) = {
   .connected    = sv_Connected,
   .disconnected = sv_Disconnected,
   .recycled     = sv_Recycled,
};

/******************************************************************************/
/*                                                                            */
/*                             PRIVATE VARIABLES                              */
/*                                                                            */
/******************************************************************************/
/**
 * @var           si64_rxStartMs
 * @brief         Uptime at which the current incoming transfer started.
 */
static int64_t si64_rxStartMs = 0;

/**
 * @var           sstar_ad
 * @brief         Advertising data.
 */
static const struct bt_data sstar_ad[] = {
   BT_DATA_BYTES(BT_DATA_FLAGS, (BT_LE_AD_GENERAL | BT_LE_AD_NO_BREDR)),
   BT_DATA(BT_DATA_NAME_COMPLETE, CONFIG_BT_DEVICE_NAME,
      sizeof(CONFIG_BT_DEVICE_NAME) - 1),
};

/**
 * @var           sstar_sd
 * @brief         Scan response data (service UUID, used by bulk_client).
 */
static const struct bt_data sstar_sd[] = {
   BT_DATA_BYTES(BT_DATA_UUID128_ALL, BT_UUID_BLK_SVC_VAL),
};

/**
 * @var           sst_advWork
 * @brief         Restarts advertising outside the Bluetooth callback context.
 */
static K_WORK_DEFINE(sst_advWork, sv_AdvWork);

/******************************************************************************/
/*                                                                            */
/*                              EXTERN FUNCTIONS                              */
/*                                                                            */
/******************************************************************************/

/******************************************************************************/
/*                                                                            */
/*                        PRIVATE FUNCTION DEFINITIONS                        */
/*                                                                            */
/******************************************************************************/
/**
 * @private       si_OnRxStart
 * @brief         BlkRxStart_F: accept every transfer and start the clock.
 * @param[in]     u8_appType Application type.
 * @param[in]     u32_totalLen Announced object size.
 * @return        0.
 */
static int si_OnRxStart(uint8_t u8_appType, uint32_t u32_totalLen)
{
   APP_LOG_INF("RX type 0x%02x: %u bytes announced", u8_appType, u32_totalLen);
   si64_rxStartMs = k_uptime_get();
   return 0;
}

/**
 * @private       si_OnRxData
 * @brief         BlkRxData_F: discarding sink (a real application writes to
 *                flash or RAM here).
 * @param[in]     u8_appType Application type (unused).
 * @param[in]     u32_offset Offset of the chunk (unused).
 * @param[in]     u8pt_data Chunk data (unused).
 * @param[in]     u16_len Chunk length (unused).
 * @return        0.
 */
static int si_OnRxData(uint8_t u8_appType, uint32_t u32_offset,
   const uint8_t *u8pt_data, uint16_t u16_len)
{
   ARG_UNUSED(u8_appType);
   ARG_UNUSED(u32_offset);
   ARG_UNUSED(u8pt_data);
   ARG_UNUSED(u16_len);

   return 0;
}

/**
 * @private       sv_OnRxDone
 * @brief         BlkRxDone_F: log the throughput and report it to the client.
 * @param[in]     u8_appType Application type.
 * @param[in]     e_status Result of the incoming transfer.
 * @param[in]     u32_totalLen Object size.
 * @return        void
 */
static void sv_OnRxDone(uint8_t u8_appType, BlkStatus_E e_status, uint32_t u32_totalLen)
{
   int64_t i64_ms = MAX(k_uptime_get() - si64_rxStartMs, 1);
   uint32_t u32_kbps = (uint32_t)(((uint64_t)u32_totalLen * 8U) / (uint64_t)i64_ms);
   uint8_t u8ar_result[9];

   APP_LOG_INF("RX type 0x%02x: %u bytes, status %u, %u kbit/s", u8_appType,
      u32_totalLen, (unsigned)e_status, u32_kbps);

   u8ar_result[0] = (uint8_t)e_status;
   sys_put_le32(u32_totalLen, &u8ar_result[1]);
   sys_put_le32(u32_kbps, &u8ar_result[5]);

   // Best effort: the link may already be gone (eBS_DISCONNECTED)
   (void)gi_BLKS_SendShort(APP_TYPE_RESULT, u8ar_result, sizeof(u8ar_result), K_MSEC(100));
}

/**
 * @private       sv_OnRxShort
 * @brief         BlkRxShort_F: echo a short message back over CTRL.
 * @param[in]     u8_appType Application type.
 * @param[in]     u8pt_data Payload.
 * @param[in]     u8_len Payload length.
 * @return        void
 */
static void sv_OnRxShort(uint8_t u8_appType, const uint8_t *u8pt_data, uint8_t u8_len)
{
   (void)gi_BLKS_SendShort(u8_appType, u8pt_data, u8_len, K_MSEC(100));
}

/**
 * @private       sv_Connected
 * @brief         bt_conn_cb.connected: bind the BulkXfer Server.
 * @param[in]     stpt_conn New connection.
 * @param[in]     u8_err HCI error (0 on success).
 * @return        void
 */
static void sv_Connected(struct bt_conn *stpt_conn, uint8_t u8_err)
{
   // Check if the connection attempt failed
   if (u8_err != 0U)
   {
      APP_LOG_ERR("connection failed (0x%02x)", u8_err);
      return;
   }

   APP_LOG_INF("connected");
   gv_BLKS_OnConnected(stpt_conn);
}

/**
 * @private       sv_Disconnected
 * @brief         bt_conn_cb.disconnected: release BulkXfer's connection.
 * @param[in]     stpt_conn Connection that went down.
 * @param[in]     u8_reason HCI disconnect reason.
 * @return        void
 */
static void sv_Disconnected(struct bt_conn *stpt_conn, uint8_t u8_reason)
{
   APP_LOG_INF("disconnected (0x%02x)", u8_reason);
   gv_BLK_OnDisconnected(stpt_conn);
}

/**
 * @private       sv_Recycled
 * @brief         bt_conn_cb.recycled: the connection object is free again,
 *                so advertising can restart.
 * @return        void
 */
static void sv_Recycled(void)
{
   k_work_submit(&sst_advWork);
}

/**
 * @private       sv_AdvWork
 * @brief         Start connectable advertising (system work queue).
 * @param[in]     stpt_work Work item (unused).
 * @return        void
 */
static void sv_AdvWork(struct k_work *stpt_work)
{
   int i_ret = 0;

   ARG_UNUSED(stpt_work);

   i_ret = bt_le_adv_start(BT_LE_ADV_CONN_FAST_1, sstar_ad, ARRAY_SIZE(sstar_ad),
      sstar_sd, ARRAY_SIZE(sstar_sd));

   // Check if advertising started (-EALREADY is fine)
   if ((i_ret != 0) && (i_ret != -EALREADY))
   {
      APP_LOG_ERR("advertising failed (%d)", i_ret);
   }
}

/******************************************************************************/
/*                                                                            */
/*                        PUBLIC FUNCTION DEFINITIONS                         */
/*                                                                            */
/******************************************************************************/
/**
 * @public        main
 * @brief         Enable Bluetooth, start the BulkXfer Server and advertise.
 * @return        0.
 */
int main(void)
{
   BlkSrvCfg_T st_cfg = { 0 };
   int i_ret = 0;

   i_ret = bt_enable(NULL);

   // Check if the Bluetooth stack started
   if (i_ret != 0)
   {
      APP_LOG_ERR("bt_enable failed (%d)", i_ret);
      return 0;
   }

   st_cfg.stpt_ctrlAttr = gstpt_BulkSvc_Init();
   st_cfg.fpt_onRxStart = si_OnRxStart;
   st_cfg.fpt_onRxData = si_OnRxData;
   st_cfg.fpt_onRxDone = sv_OnRxDone;
   st_cfg.fpt_onRxShort = sv_OnRxShort;
   st_cfg.b_autoTuneLink = true;

   i_ret = gi_BLKS_Init(&st_cfg);

   // Check if BulkXfer started
   if (i_ret != 0)
   {
      APP_LOG_ERR("gi_BLKS_Init failed (%d)", i_ret);
      return 0;
   }

   // Advertise only after init: earlier connections would be ignored
   k_work_submit(&sst_advWork);
   APP_LOG_INF("BulkXfer server ready");

   return 0;
}
```

## src/BulkXfer_Service.c
```c
/**
 * @file          BulkXfer_Service.c
 * @brief         Example BulkXfer GATT service, written in the style emitted
 *                by the GATT configurator in generic-callback mode.
 *
 *                Characteristics:
 *                  DATA (Write | Write Without Response): client -> server
 *                       frames. gt_GATT_GenericWrite + custom write hook that
 *                       forwards to gt_BLKS_DataWriteHook().
 *                  CTRL (Notify): server -> client control frames, sent by
 *                       BulkXfer with bt_gatt_notify_cb(). No read/write
 *                       callbacks.
 *                  Caps (Read): BlkCaps_T, served by gt_GATT_GenericRead.
 *
 * @date          24/09/2026
 * @author        Shivam Chudasama
 * @copyright     Shivam Chudasama
 * @license       MIT
 */

/* SPDX-License-Identifier: MIT */

/******************************************************************************/
/*                                                                            */
/*                                  INCLUDES                                  */
/*                                                                            */
/******************************************************************************/
#include "BulkXfer_Service.h"
#include "GATT_GenericCallbacks.h"
#include "BulkXfer.h"

/******************************************************************************/
/*                                                                            */
/*                                  DEFINES                                   */
/*                                                                            */
/******************************************************************************/

/******************************************************************************/
/*                                                                            */
/*                                   ENUMS                                    */
/*                                                                            */
/******************************************************************************/

/******************************************************************************/
/*                                                                            */
/*                                 STRUCTURES                                 */
/*                                                                            */
/******************************************************************************/

/******************************************************************************/
/*                                                                            */
/*                                   UNIONS                                   */
/*                                                                            */
/******************************************************************************/

/******************************************************************************/
/*                                                                            */
/*                       PRIVATE FUNCTION DECLARATIONS                        */
/*                                                                            */
/******************************************************************************/
static ssize_t st_OnBulkDataWrite(struct bt_conn *stpt_connHandle,
   const struct bt_gatt_attr *stpt_attr, const void *vpt_buf, uint16_t u16_length,
   uint16_t u16_offset, uint8_t u8_flags);

/******************************************************************************/
/*                                                                            */
/*                              EXTERN VARIABLES                              */
/*                                                                            */
/******************************************************************************/

/******************************************************************************/
/*                                                                            */
/*                             PRIVATE VARIABLES                              */
/*                                                                            */
/******************************************************************************/
/**
 * @var           su8ar_dataFrame
 * @brief         Scratch copy made by gt_GATT_GenericWrite (one full frame).
 */
static uint8_t su8ar_dataFrame[BLK_MAX_FRAME_LEN];

/**
 * @var           sst_caps
 * @brief         Capability record served to the client.
 */
static BlkCaps_T sst_caps;

/**
 * @var           sst_dataFrameDesc
 * @brief         Descriptor for the 'DATA' characteristic. Variable length up to
 *                BLK_MAX_FRAME_LEN; the hook passes every frame to BulkXfer.
 *                No mutex: the buffer is only touched in BLE RX context.
 */
static GATTCharDescriptor_T sst_dataFrameDesc = {
   .vpt_data          = su8ar_dataFrame,
   .u16_dataLen       = sizeof(su8ar_dataFrame),
   .u16_actualLen     = 0U,
   .b_variableLength  = true,
   .stpt_mutex        = NULL,
   .fpt_customReadCb  = NULL,
   .fpt_customWriteCb = st_OnBulkDataWrite,
};

/**
 * @var           sst_capsDesc
 * @brief         Descriptor for the 'Caps' characteristic (fixed length).
 */
static GATTCharDescriptor_T sst_capsDesc = {
   .vpt_data          = &sst_caps,
   .u16_dataLen       = sizeof(sst_caps),
   .u16_actualLen     = sizeof(sst_caps),
   .b_variableLength  = false,
   .stpt_mutex        = NULL,
   .fpt_customReadCb  = NULL,
   .fpt_customWriteCb = NULL,
};

/******************************************************************************/
/*                                                                            */
/*                              PUBLIC VARIABLES                              */
/*                                                                            */
/******************************************************************************/
/**
 * @var           gst_bulkXferSvc
 * @brief         BulkXfer service instance. BT_GATT_SERVICE_DEFINE gives it
 *                external linkage. Defined after the private descriptors it
 *                references.
 */
BT_GATT_SERVICE_DEFINE(gst_bulkXferSvc,
   BT_GATT_PRIMARY_SERVICE(BT_UUID_BLK_SVC),

   // DATA: client -> server frames (bulk data)
   BT_GATT_CHARACTERISTIC(BT_UUID_BLK_DATA,
      BT_GATT_CHRC_WRITE | BT_GATT_CHRC_WRITE_WITHOUT_RESP,
      BT_GATT_PERM_WRITE,
      NULL, gt_GATT_GenericWrite, &sst_dataFrameDesc),

   // CTRL: server -> client control frames
   BT_GATT_CHARACTERISTIC(BT_UUID_BLK_CTRL,
      BT_GATT_CHRC_NOTIFY,
      BT_GATT_PERM_NONE,
      NULL, NULL, NULL),
   BT_GATT_CCC(NULL, BT_GATT_PERM_READ | BT_GATT_PERM_WRITE),

   // Caps: protocol capabilities
   BT_GATT_CHARACTERISTIC(BT_UUID_BLK_CAPS,
      BT_GATT_CHRC_READ,
      BT_GATT_PERM_READ,
      gt_GATT_GenericRead, NULL, &sst_capsDesc),
);

/******************************************************************************/
/*                                                                            */
/*                              EXTERN FUNCTIONS                              */
/*                                                                            */
/******************************************************************************/

/******************************************************************************/
/*                                                                            */
/*                        PRIVATE FUNCTION DEFINITIONS                        */
/*                                                                            */
/******************************************************************************/
/**
 * @private       st_OnBulkDataWrite
 * @brief         Custom write hook of the DATA characteristic (the name
 *                entered in the configurator). Forwards to the BulkXfer Server.
 * @param[in]     stpt_connHandle Connection that wrote.
 * @param[in]     stpt_attr DATA attribute.
 * @param[in]     vpt_buf Written bytes (one frame).
 * @param[in]     u16_length Number of bytes.
 * @param[in]     u16_offset Write offset.
 * @param[in]     u8_flags Write flags.
 * @return        Result of gt_BLKS_DataWriteHook().
 */
static ssize_t st_OnBulkDataWrite(struct bt_conn *stpt_connHandle,
   const struct bt_gatt_attr *stpt_attr, const void *vpt_buf, uint16_t u16_length,
   uint16_t u16_offset, uint8_t u8_flags)
{
   return gt_BLKS_DataWriteHook(stpt_connHandle, stpt_attr, vpt_buf, u16_length,
      u16_offset, u8_flags);
}

/******************************************************************************/
/*                                                                            */
/*                        PUBLIC FUNCTION DEFINITIONS                         */
/*                                                                            */
/******************************************************************************/
/**
 * @public        gstpt_BulkSvc_Init
 * @brief         Publish the capability record and locate the CTRL value
 *                attribute for BlkSrvCfg_T.stpt_ctrlAttr.
 * @return        CTRL value attribute (never NULL for this static service).
 */
const struct bt_gatt_attr *gstpt_BulkSvc_Init(void)
{
   BlkCaps_T st_caps;

   gv_BLKS_GetCaps(&st_caps);
   gv_GATT_LocalWrite(&sst_capsDesc, &st_caps, sizeof(st_caps));

   // Returns the value attribute, which notify and the CCC lookup expect
   return bt_gatt_find_by_uuid(gst_bulkXferSvc.attrs, gst_bulkXferSvc.attr_count,
      BT_UUID_BLK_CTRL);
}
```

## src/BulkXfer_Service.h
```c
/**
 * @file          BulkXfer_Service.h
 * @brief         Init API of the example BulkXfer GATT service. The UUIDs are
 *                the library defaults from BulkXfer_Uuid.h.
 * @date          24/09/2026
 * @author        Shivam Chudasama
 * @copyright     Shivam Chudasama
 * @license       MIT
 */

/* SPDX-License-Identifier: MIT */

#ifndef _BULK_XFER_SERVICE_H
#define _BULK_XFER_SERVICE_H

/******************************************************************************/
/*                                                                            */
/*                                  INCLUDES                                  */
/*                                                                            */
/******************************************************************************/
#include <zephyr/bluetooth/gatt.h>
#include "BulkXfer_Uuid.h"

/******************************************************************************/
/*                                                                            */
/*                                  DEFINES                                   */
/*                                                                            */
/******************************************************************************/

/******************************************************************************/
/*                                                                            */
/*                                   ENUMS                                    */
/*                                                                            */
/******************************************************************************/

/******************************************************************************/
/*                                                                            */
/*                                 STRUCTURES                                 */
/*                                                                            */
/******************************************************************************/

/******************************************************************************/
/*                                                                            */
/*                                   UNIONS                                   */
/*                                                                            */
/******************************************************************************/

/******************************************************************************/
/*                                                                            */
/*                              EXTERN VARIABLES                              */
/*                                                                            */
/******************************************************************************/

/******************************************************************************/
/*                                                                            */
/*                              EXTERN FUNCTIONS                              */
/*                                                                            */
/******************************************************************************/
extern const struct bt_gatt_attr *gstpt_BulkSvc_Init(void);

#endif // _BULK_XFER_SERVICE_H
```

## src/app_log.c
```c
/* SPDX-License-Identifier: MIT */
/* Registers the APP_LOG module that AppLog.h declares in every other file. */
#include <zephyr/logging/log.h>

LOG_MODULE_REGISTER(APP_LOG, LOG_LEVEL_INF);
```
