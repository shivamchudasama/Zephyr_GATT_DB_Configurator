## CMakeLists.txt
```
# SPDX-License-Identifier: MIT
cmake_minimum_required(VERSION 3.20.0)

find_package(Zephyr REQUIRED HINTS $ENV{ZEPHYR_BASE})
project(bulkxfer_peripheral_echo)

target_sources(app PRIVATE
   src/main.c
   src/app_log.c
   src/BulkXfer_Service.c
)

target_include_directories(app PRIVATE
   src
   ${CMAKE_CURRENT_LIST_DIR}/../../../AppLog
)

# Library sources (each CMakeLists adds its *.c files to the app target)
add_subdirectory(${CMAKE_CURRENT_LIST_DIR}/../../../GATT_CB GATT_CB)
add_subdirectory(${CMAKE_CURRENT_LIST_DIR}/../.. BulkXfer)
```

## prj.conf
```kconfig
# SPDX-License-Identifier: MIT
# BulkXfer echo peripheral - throughput-oriented baseline for nRF54 + NCS.

CONFIG_LOG=y
CONFIG_CRC=y
CONFIG_MAIN_STACK_SIZE=2048

CONFIG_BT=y
CONFIG_BT_PERIPHERAL=y
CONFIG_BT_DEVICE_NAME="BulkXfer"
CONFIG_BT_MAX_CONN=1
# Lets the peripheral start the ATT MTU exchange itself (most phones also do).
CONFIG_BT_GATT_CLIENT=y

# ATT_MTU 247 -> 244-byte notification/write payload = one 251-byte LL packet.
CONFIG_BT_L2CAP_TX_MTU=247
CONFIG_BT_BUF_ACL_RX_SIZE=251
CONFIG_BT_BUF_ACL_TX_SIZE=251
CONFIG_BT_CTLR_DATA_LENGTH_MAX=251

# Link tuning requested by gv_BLK_OnConnected() (b_autoTuneLink = true).
CONFIG_BT_USER_DATA_LEN_UPDATE=y
CONFIG_BT_USER_PHY_UPDATE=y
CONFIG_BT_CTLR_PHY_2M=y

# Enough host/controller buffers to fill each connection event.
# BLK_TX_INFLIGHT_MAX (default 6) must stay below BT_ATT_TX_COUNT.
CONFIG_BT_ATT_TX_COUNT=10
CONFIG_BT_CONN_TX_MAX=10
CONFIG_BT_BUF_ACL_TX_COUNT=10
# Must exceed BT_BUF_ACL_TX_COUNT (one completion event per ACL buffer).
CONFIG_BT_BUF_EVT_RX_COUNT=11
CONFIG_BT_ATT_PREPARE_COUNT=0

# Let the SoftDevice Controller extend connection events for many packets.
CONFIG_BT_CTLR_SDC_MAX_CONN_EVENT_LEN_DEFAULT=4000000

# Preferred connection interval 7.5-15 ms (units of 1.25 ms).
CONFIG_BT_PERIPHERAL_PREF_MIN_INT=6
CONFIG_BT_PERIPHERAL_PREF_MAX_INT=12
CONFIG_BT_PERIPHERAL_PREF_LATENCY=0
CONFIG_BT_PERIPHERAL_PREF_TIMEOUT=400
```

## src/main.c
```c
/**
 * @file          main.c
 * @brief         BulkXfer echo peripheral.
 *
 *                - Any multi-frame transfer received from the central (up to
 *                  ECHO_BUF_SIZE bytes) is sent back unchanged with the same
 *                  application type once it completed with eBS_OK.
 *                - Any short message is echoed back as a short message.
 *
 *                Use it with tools/bulkxfer_client.py to test both directions
 *                and measure throughput.
 *
 * @date          22/09/2026
 * @author        Shivam Chudasama
 * @copyright     Shivam Chudasama
 * @license       MIT
 */

/* SPDX-License-Identifier: MIT */

/******************************************************************************/
/*                                                                            */
/*                                  INCLUDES                                  */
/*                                                                            */
/******************************************************************************/
#include <string.h>
#include <zephyr/kernel.h>
#include <zephyr/bluetooth/bluetooth.h>
#include <zephyr/bluetooth/conn.h>
#include "BulkXfer.h"
#include "BulkXfer_Service.h"
#include "AppLog.h"

/******************************************************************************/
/*                                                                            */
/*                                  DEFINES                                   */
/*                                                                            */
/******************************************************************************/
/**
 * @def           ECHO_BUF_SIZE
 * @brief         Largest object the peripheral accepts and echoes back.
 */
#define ECHO_BUF_SIZE                        (32U * 1024U)

/******************************************************************************/
/*                                                                            */
/*                                   ENUMS                                    */
/*                                                                            */
/******************************************************************************/

/******************************************************************************/
/*                                                                            */
/*                                 STRUCTURES                                 */
/*                                                                            */
/******************************************************************************/

/******************************************************************************/
/*                                                                            */
/*                                   UNIONS                                   */
/*                                                                            */
/******************************************************************************/

/******************************************************************************/
/*                                                                            */
/*                       PRIVATE FUNCTION DECLARATIONS                        */
/*                                                                            */
/******************************************************************************/
static int si_OnRxStart(uint8_t u8_appType, uint32_t u32_totalLen);
static int si_OnRxData(uint8_t u8_appType, uint32_t u32_offset,
   const uint8_t *u8pt_data, uint16_t u16_len);
static void sv_OnRxDone(uint8_t u8_appType, BlkStatus_E e_status, uint32_t u32_totalLen);
static void sv_OnRxShort(uint8_t u8_appType, const uint8_t *u8pt_data, uint8_t u8_len);
static void sv_OnTxDone(uint8_t u8_appType, BlkStatus_E e_status);
static void sv_Connected(struct bt_conn *stpt_conn, uint8_t u8_err);
static void sv_Disconnected(struct bt_conn *stpt_conn, uint8_t u8_reason);
static void sv_Recycled(void);
static void sv_AdvWork(struct k_work *stpt_work);

/******************************************************************************/
/*                                                                            */
/*                              EXTERN VARIABLES                              */
/*                                                                            */
/******************************************************************************/

/******************************************************************************/
/*                                                                            */
/*                              PUBLIC VARIABLES                              */
/*                                                                            */
/******************************************************************************/
/**
 * @var           gst_connCallbacks
 * @brief         Connection callbacks. BT_CONN_CB_DEFINE gives the object
 *                external linkage.
 */
BT_CONN_CB_DEFINE(gst_connCallbacks) = {
   .connected    = sv_Connected,
   .disconnected = sv_Disconnected,
   .recycled     = sv_Recycled,
};

/******************************************************************************/
/*                                                                            */
/*                             PRIVATE VARIABLES                              */
/*                                                                            */
/******************************************************************************/
/**
 * @var           su8ar_echo
 * @brief         Holds the received object until it has been echoed back.
 */
static uint8_t su8ar_echo[ECHO_BUF_SIZE];

/**
 * @var           si64_rxStartMs
 * @brief         Uptime at which the current incoming transfer started.
 */
static int64_t si64_rxStartMs = 0;

/**
 * @var           sstar_ad
 * @brief         Advertising data.
 */
static const struct bt_data sstar_ad[] = {
   BT_DATA_BYTES(BT_DATA_FLAGS, (BT_LE_AD_GENERAL | BT_LE_AD_NO_BREDR)),
   BT_DATA(BT_DATA_NAME_COMPLETE, CONFIG_BT_DEVICE_NAME,
      sizeof(CONFIG_BT_DEVICE_NAME) - 1),
};

/**
 * @var           sstar_sd
 * @brief         Scan response data (service UUID).
 */
static const struct bt_data sstar_sd[] = {
   BT_DATA_BYTES(BT_DATA_UUID128_ALL, BT_UUID_BULK_XFER_SVC_VAL),
};

/**
 * @var           sst_advWork
 * @brief         Restarts advertising outside the Bluetooth callback context.
 */
static K_WORK_DEFINE(sst_advWork, sv_AdvWork);

/******************************************************************************/
/*                                                                            */
/*                              EXTERN FUNCTIONS                              */
/*                                                                            */
/******************************************************************************/

/******************************************************************************/
/*                                                                            */
/*                        PRIVATE FUNCTION DEFINITIONS                        */
/*                                                                            */
/******************************************************************************/
/**
 * @private       si_OnRxStart
 * @brief         BlkRxStart_F: accept a transfer if it fits the echo buffer and
 *                the previous echo has been sent.
 * @param[in]     u8_appType Application type (unused).
 * @param[in]     u32_totalLen Announced object size.
 * @return        0 to accept, -ENOMEM to reject.
 */
static int si_OnRxStart(uint8_t u8_appType, uint32_t u32_totalLen)
{
   ARG_UNUSED(u8_appType);

   // Check if the object fits and the echo buffer is not being sent back
   // (it is also the source of the running echo)
   if ((u32_totalLen > sizeof(su8ar_echo)) || gb_BLK_IsTxBusy())
   {
      APP_LOG_WRN("rejecting %u bytes", u32_totalLen);
      return -ENOMEM;
   }

   si64_rxStartMs = k_uptime_get();
   return 0;
}

/**
 * @private       si_OnRxData
 * @brief         BlkRxData_F: copy the chunk into the echo buffer.
 * @param[in]     u8_appType Application type (unused).
 * @param[in]     u32_offset Offset of the chunk within the object.
 * @param[in]     u8pt_data Chunk data.
 * @param[in]     u16_len Chunk length.
 * @return        0.
 */
static int si_OnRxData(uint8_t u8_appType, uint32_t u32_offset,
   const uint8_t *u8pt_data, uint16_t u16_len)
{
   ARG_UNUSED(u8_appType);

   (void)memcpy(&su8ar_echo[u32_offset], u8pt_data, u16_len);
   return 0;
}

/**
 * @private       sv_OnRxDone
 * @brief         BlkRxDone_F: log the throughput and echo a complete object.
 * @param[in]     u8_appType Application type, reused for the echo.
 * @param[in]     e_status Result of the incoming transfer.
 * @param[in]     u32_totalLen Object size.
 * @return        void
 */
static void sv_OnRxDone(uint8_t u8_appType, BlkStatus_E e_status, uint32_t u32_totalLen)
{
   int64_t i64_ms = MAX(k_uptime_get() - si64_rxStartMs, 1);
   int i_ret = 0;

   APP_LOG_INF("RX type 0x%02x: %u bytes, status %u, %u kbit/s", u8_appType,
      u32_totalLen, (unsigned)e_status, (uint32_t)(((uint64_t)u32_totalLen * 8U) / i64_ms));

   // Check if the object arrived intact
   if (e_status != eBS_OK)
   {
      return;
   }

   i_ret = gi_BLK_SendBuffer(u8_appType, su8ar_echo, u32_totalLen);

   // Check if the echo could be started
   if (i_ret != 0)
   {
      APP_LOG_ERR("echo not started (%d)", i_ret);
   }
}

/**
 * @private       sv_OnRxShort
 * @brief         BlkRxShort_F: echo a short message back.
 * @param[in]     u8_appType Application type.
 * @param[in]     u8pt_data Payload.
 * @param[in]     u8_len Payload length.
 * @return        void
 */
static void sv_OnRxShort(uint8_t u8_appType, const uint8_t *u8pt_data, uint8_t u8_len)
{
   (void)gi_BLK_SendShort(u8_appType, u8pt_data, u8_len, K_MSEC(100));
}

/**
 * @private       sv_OnTxDone
 * @brief         BlkTxDone_F: log the result of an echo.
 * @param[in]     u8_appType Application type.
 * @param[in]     e_status Result of the outgoing transfer.
 * @return        void
 */
static void sv_OnTxDone(uint8_t u8_appType, BlkStatus_E e_status)
{
   APP_LOG_INF("TX type 0x%02x done, status %u", u8_appType, (unsigned)e_status);
}

/**
 * @private       sv_Connected
 * @brief         bt_conn_cb.connected: bind BulkXfer to the new connection.
 * @param[in]     stpt_conn New connection.
 * @param[in]     u8_err HCI error (0 on success).
 * @return        void
 */
static void sv_Connected(struct bt_conn *stpt_conn, uint8_t u8_err)
{
   // Check if the connection attempt failed
   if (u8_err != 0U)
   {
      APP_LOG_ERR("connection failed (0x%02x)", u8_err);
      return;
   }

   APP_LOG_INF("connected");
   gv_BLK_OnConnected(stpt_conn);
}

/**
 * @private       sv_Disconnected
 * @brief         bt_conn_cb.disconnected: release BulkXfer's connection.
 * @param[in]     stpt_conn Connection that went down.
 * @param[in]     u8_reason HCI disconnect reason.
 * @return        void
 */
static void sv_Disconnected(struct bt_conn *stpt_conn, uint8_t u8_reason)
{
   APP_LOG_INF("disconnected (0x%02x)", u8_reason);
   gv_BLK_OnDisconnected(stpt_conn);
}

/**
 * @private       sv_Recycled
 * @brief         bt_conn_cb.recycled: the connection object is free again,
 *                so advertising can restart.
 * @return        void
 */
static void sv_Recycled(void)
{
   // Only now is the conn object free for a new connection
   k_work_submit(&sst_advWork);
}

/**
 * @private       sv_AdvWork
 * @brief         Start connectable advertising (system work queue).
 * @param[in]     stpt_work Work item (unused).
 * @return        void
 */
static void sv_AdvWork(struct k_work *stpt_work)
{
   int i_ret = 0;

   ARG_UNUSED(stpt_work);

   i_ret = bt_le_adv_start(BT_LE_ADV_CONN_FAST_1, sstar_ad, ARRAY_SIZE(sstar_ad),
      sstar_sd, ARRAY_SIZE(sstar_sd));

   // Check if advertising started (-EALREADY is fine)
   if ((i_ret != 0) && (i_ret != -EALREADY))
   {
      APP_LOG_ERR("advertising failed (%d)", i_ret);
   }
}

/******************************************************************************/
/*                                                                            */
/*                        PUBLIC FUNCTION DEFINITIONS                         */
/*                                                                            */
/******************************************************************************/
/**
 * @public        main
 * @brief         Enable Bluetooth, start BulkXfer and begin advertising.
 * @return        0.
 */
int main(void)
{
   BlkCfg_T st_cfg = { 0 };
   int i_ret = 0;

   i_ret = bt_enable(NULL);

   // Check if the Bluetooth stack started
   if (i_ret != 0)
   {
      APP_LOG_ERR("bt_enable failed (%d)", i_ret);
      return 0;
   }

   st_cfg.stpt_txAttr = gstpt_BulkSvc_Init();
   st_cfg.fpt_onRxStart = si_OnRxStart;
   st_cfg.fpt_onRxData = si_OnRxData;
   st_cfg.fpt_onRxDone = sv_OnRxDone;
   st_cfg.fpt_onRxShort = sv_OnRxShort;
   st_cfg.fpt_onTxDone = sv_OnTxDone;
   st_cfg.b_autoTuneLink = true;

   i_ret = gi_BLK_Init(&st_cfg);

   // Check if BulkXfer started
   if (i_ret != 0)
   {
      APP_LOG_ERR("gi_BLK_Init failed (%d)", i_ret);
      return 0;
   }

   // Advertise only after init: earlier connections would be ignored
   k_work_submit(&sst_advWork);
   APP_LOG_INF("BulkXfer echo peripheral ready");

   return 0;
}
```

## src/BulkXfer_Service.c
```c
/**
 * @file          BulkXfer_Service.c
 * @brief         Example BulkXfer GATT service, written in the style emitted
 *                by the GATT configurator in generic-callback mode.
 *
 *                Characteristics:
 *                  RX   (Write | Write Without Response): central -> device
 *                       frames. gt_GATT_GenericWrite + custom write hook that
 *                       forwards to gt_BLK_RxWriteHook().
 *                  TX   (Notify): device -> central frames, sent by BulkXfer
 *                       with bt_gatt_notify_cb(). No read/write callbacks.
 *                  Caps (Read): BlkCaps_T, served by gt_GATT_GenericRead.
 *
 * @date          22/09/2026
 * @author        Shivam Chudasama
 * @copyright     Shivam Chudasama
 * @license       MIT
 */

/* SPDX-License-Identifier: MIT */

/******************************************************************************/
/*                                                                            */
/*                                  INCLUDES                                  */
/*                                                                            */
/******************************************************************************/
#include "BulkXfer_Service.h"
#include "GATT_GenericCallbacks.h"
#include "BulkXfer.h"

/******************************************************************************/
/*                                                                            */
/*                                  DEFINES                                   */
/*                                                                            */
/******************************************************************************/

/******************************************************************************/
/*                                                                            */
/*                                   ENUMS                                    */
/*                                                                            */
/******************************************************************************/

/******************************************************************************/
/*                                                                            */
/*                                 STRUCTURES                                 */
/*                                                                            */
/******************************************************************************/

/******************************************************************************/
/*                                                                            */
/*                                   UNIONS                                   */
/*                                                                            */
/******************************************************************************/

/******************************************************************************/
/*                                                                            */
/*                       PRIVATE FUNCTION DECLARATIONS                        */
/*                                                                            */
/******************************************************************************/
static ssize_t st_OnBulkRxWrite(struct bt_conn *stpt_connHandle,
   const struct bt_gatt_attr *stpt_attr, const void *vpt_buf, uint16_t u16_length,
   uint16_t u16_offset, uint8_t u8_flags);

/******************************************************************************/
/*                                                                            */
/*                              EXTERN VARIABLES                              */
/*                                                                            */
/******************************************************************************/

/******************************************************************************/
/*                                                                            */
/*                             PRIVATE VARIABLES                              */
/*                                                                            */
/******************************************************************************/
/**
 * @var           su8ar_rxFrame
 * @brief         Scratch copy made by gt_GATT_GenericWrite (one full frame).
 */
static uint8_t su8ar_rxFrame[BLK_MAX_FRAME_LEN];

/**
 * @var           sst_caps
 * @brief         Capability record served to the central.
 */
static BlkCaps_T sst_caps;

/**
 * @var           sst_rxFrameDesc
 * @brief         Descriptor for the 'RX' characteristic. Variable length up to
 *                BLK_MAX_FRAME_LEN; the hook passes every frame to BulkXfer.
 *                No mutex: the buffer is only touched in BLE RX context.
 */
static GATTCharDescriptor_T sst_rxFrameDesc = {
   .vpt_data          = su8ar_rxFrame,
   .u16_dataLen       = sizeof(su8ar_rxFrame),
   .u16_actualLen     = 0U,
   .b_variableLength  = true,
   .stpt_mutex        = NULL,
   .fpt_customReadCb  = NULL,
   .fpt_customWriteCb = st_OnBulkRxWrite,
};

/**
 * @var           sst_capsDesc
 * @brief         Descriptor for the 'Caps' characteristic (fixed length).
 */
static GATTCharDescriptor_T sst_capsDesc = {
   .vpt_data          = &sst_caps,
   .u16_dataLen       = sizeof(sst_caps),
   .u16_actualLen     = sizeof(sst_caps),
   .b_variableLength  = false,
   .stpt_mutex        = NULL,
   .fpt_customReadCb  = NULL,
   .fpt_customWriteCb = NULL,
};

/******************************************************************************/
/*                                                                            */
/*                              PUBLIC VARIABLES                              */
/*                                                                            */
/******************************************************************************/
/**
 * @var           gst_bulkXferSvc
 * @brief         BulkXfer service instance. BT_GATT_SERVICE_DEFINE gives it
 *                external linkage. Defined after the private descriptors it
 *                references.
 */
BT_GATT_SERVICE_DEFINE(gst_bulkXferSvc,
   BT_GATT_PRIMARY_SERVICE(BT_UUID_BULK_XFER_SVC),

   // RX: central -> device frames
   BT_GATT_CHARACTERISTIC(BT_UUID_BULK_XFER_RX,
      BT_GATT_CHRC_WRITE | BT_GATT_CHRC_WRITE_WITHOUT_RESP,
      BT_GATT_PERM_WRITE,
      NULL, gt_GATT_GenericWrite, &sst_rxFrameDesc),

   // TX: device -> central frames
   BT_GATT_CHARACTERISTIC(BT_UUID_BULK_XFER_TX,
      BT_GATT_CHRC_NOTIFY,
      BT_GATT_PERM_NONE,
      NULL, NULL, NULL),
   BT_GATT_CCC(NULL, BT_GATT_PERM_READ | BT_GATT_PERM_WRITE),

   // Caps: protocol capabilities
   BT_GATT_CHARACTERISTIC(BT_UUID_BULK_XFER_CAPS,
      BT_GATT_CHRC_READ,
      BT_GATT_PERM_READ,
      gt_GATT_GenericRead, NULL, &sst_capsDesc),
);

/******************************************************************************/
/*                                                                            */
/*                              EXTERN FUNCTIONS                              */
/*                                                                            */
/******************************************************************************/

/******************************************************************************/
/*                                                                            */
/*                        PRIVATE FUNCTION DEFINITIONS                        */
/*                                                                            */
/******************************************************************************/
/**
 * @private       st_OnBulkRxWrite
 * @brief         Custom write hook of the RX characteristic (the name entered
 *                in the configurator). Forwards to the BulkXfer engine.
 * @param[in]     stpt_connHandle Connection that wrote.
 * @param[in]     stpt_attr RX attribute.
 * @param[in]     vpt_buf Written bytes (one frame).
 * @param[in]     u16_length Number of bytes.
 * @param[in]     u16_offset Write offset.
 * @param[in]     u8_flags Write flags.
 * @return        Result of gt_BLK_RxWriteHook().
 */
static ssize_t st_OnBulkRxWrite(struct bt_conn *stpt_connHandle,
   const struct bt_gatt_attr *stpt_attr, const void *vpt_buf, uint16_t u16_length,
   uint16_t u16_offset, uint8_t u8_flags)
{
   return gt_BLK_RxWriteHook(stpt_connHandle, stpt_attr, vpt_buf, u16_length,
      u16_offset, u8_flags);
}

/******************************************************************************/
/*                                                                            */
/*                        PUBLIC FUNCTION DEFINITIONS                         */
/*                                                                            */
/******************************************************************************/
/**
 * @public        gstpt_BulkSvc_Init
 * @brief         Publish the capability record and locate the TX value
 *                attribute for BlkCfg_T.stpt_txAttr.
 * @return        TX value attribute (never NULL for this static service).
 */
const struct bt_gatt_attr *gstpt_BulkSvc_Init(void)
{
   BlkCaps_T st_caps;

   gv_BLK_GetCaps(&st_caps);
   gv_GATT_LocalWrite(&sst_capsDesc, &st_caps, sizeof(st_caps));

   // Returns the value attribute, which notify and the CCC lookup expect
   return bt_gatt_find_by_uuid(gst_bulkXferSvc.attrs, gst_bulkXferSvc.attr_count,
      BT_UUID_BULK_XFER_TX);
}
```

## src/BulkXfer_Service.h
```c
/**
 * @file          BulkXfer_Service.h
 * @brief         UUIDs and init API of the example BulkXfer GATT service.
 * @date          22/09/2026
 * @author        Shivam Chudasama
 * @copyright     Shivam Chudasama
 * @license       MIT
 */

/* SPDX-License-Identifier: MIT */

#ifndef _BULK_XFER_SERVICE_H
#define _BULK_XFER_SERVICE_H

/******************************************************************************/
/*                                                                            */
/*                                  INCLUDES                                  */
/*                                                                            */
/******************************************************************************/
#include <zephyr/bluetooth/uuid.h>
#include <zephyr/bluetooth/gatt.h>

/******************************************************************************/
/*                                                                            */
/*                                  DEFINES                                   */
/*                                                                            */
/******************************************************************************/
/**
 * @def           BT_UUID_BULK_XFER_SVC_VAL
 * @brief         128-bit UUID of the BulkXfer service:
 *                B1C00001-2F5B-4E6A-9C1D-7A3E5F8B0C21.
 */
#define BT_UUID_BULK_XFER_SVC_VAL \
   BT_UUID_128_ENCODE(0xB1C00001, 0x2F5B, 0x4E6A, 0x9C1D, 0x7A3E5F8B0C21)

/**
 * @def           BT_UUID_BULK_XFER_RX_VAL
 * @brief         128-bit UUID of the BulkXfer RX characteristic
 *                (central -> device frames):
 *                B1C00002-2F5B-4E6A-9C1D-7A3E5F8B0C21.
 */
#define BT_UUID_BULK_XFER_RX_VAL \
   BT_UUID_128_ENCODE(0xB1C00002, 0x2F5B, 0x4E6A, 0x9C1D, 0x7A3E5F8B0C21)

/**
 * @def           BT_UUID_BULK_XFER_TX_VAL
 * @brief         128-bit UUID of the BulkXfer TX characteristic
 *                (device -> central frames):
 *                B1C00003-2F5B-4E6A-9C1D-7A3E5F8B0C21.
 */
#define BT_UUID_BULK_XFER_TX_VAL \
   BT_UUID_128_ENCODE(0xB1C00003, 0x2F5B, 0x4E6A, 0x9C1D, 0x7A3E5F8B0C21)

/**
 * @def           BT_UUID_BULK_XFER_CAPS_VAL
 * @brief         128-bit UUID of the BulkXfer Caps characteristic (BlkCaps_T):
 *                B1C00004-2F5B-4E6A-9C1D-7A3E5F8B0C21.
 */
#define BT_UUID_BULK_XFER_CAPS_VAL \
   BT_UUID_128_ENCODE(0xB1C00004, 0x2F5B, 0x4E6A, 0x9C1D, 0x7A3E5F8B0C21)

/**
 * @def           BT_UUID_BULK_XFER_SVC
 * @brief         bt_uuid form of BT_UUID_BULK_XFER_SVC_VAL.
 */
#define BT_UUID_BULK_XFER_SVC      BT_UUID_DECLARE_128(BT_UUID_BULK_XFER_SVC_VAL)

/**
 * @def           BT_UUID_BULK_XFER_RX
 * @brief         bt_uuid form of BT_UUID_BULK_XFER_RX_VAL.
 */
#define BT_UUID_BULK_XFER_RX       BT_UUID_DECLARE_128(BT_UUID_BULK_XFER_RX_VAL)

/**
 * @def           BT_UUID_BULK_XFER_TX
 * @brief         bt_uuid form of BT_UUID_BULK_XFER_TX_VAL.
 */
#define BT_UUID_BULK_XFER_TX       BT_UUID_DECLARE_128(BT_UUID_BULK_XFER_TX_VAL)

/**
 * @def           BT_UUID_BULK_XFER_CAPS
 * @brief         bt_uuid form of BT_UUID_BULK_XFER_CAPS_VAL.
 */
#define BT_UUID_BULK_XFER_CAPS     BT_UUID_DECLARE_128(BT_UUID_BULK_XFER_CAPS_VAL)

/******************************************************************************/
/*                                                                            */
/*                                   ENUMS                                    */
/*                                                                            */
/******************************************************************************/

/******************************************************************************/
/*                                                                            */
/*                                 STRUCTURES                                 */
/*                                                                            */
/******************************************************************************/

/******************************************************************************/
/*                                                                            */
/*                                   UNIONS                                   */
/*                                                                            */
/******************************************************************************/

/******************************************************************************/
/*                                                                            */
/*                              EXTERN VARIABLES                              */
/*                                                                            */
/******************************************************************************/

/******************************************************************************/
/*                                                                            */
/*                              EXTERN FUNCTIONS                              */
/*                                                                            */
/******************************************************************************/
extern const struct bt_gatt_attr *gstpt_BulkSvc_Init(void);

#endif // _BULK_XFER_SERVICE_H
```
